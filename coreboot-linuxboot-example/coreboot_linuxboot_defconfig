## coreboot-linuxboot-example/coreboot_linuxboot_defconfig
```kconfig
CONFIG_CBFS_SIZE=0xF00000
CONFIG_BOARD_EMULATION_QEMU_X86_Q35=y
CONFIG_PAYLOAD_ELF=y
CONFIG_PAYLOAD_FILE="inputs/bzImage"
CONFIG_COMPRESSED_PAYLOAD_NONE=y
```
